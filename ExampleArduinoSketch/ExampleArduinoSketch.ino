/* Image data for happy.bmp 123x120 */
/* Generated by MonochromeBMP2Array */
/* Source code available at https://github.com/Krugaroo/MonochromeBMP2Array  */
/*
***************************************************************************************************************************     
***************************************************************************************************************************     
***************************************************************************************************************************     
********************************************* *****************************************************************************     
******************************************** **********************************    ****************************************     
******************************************** **********************************    ****************************************     
******************************************  *  *******************************  **   **************     *******************     
****************************************  ****   *********************** ***** *****               * **********************     
*****************         ************  *******  **********************  ****  *********** ********        ****************     
*******************    ***      ***   *********   ************** ****   ****  *****************************    ************     
***********************  *******   ********** *   ************** ***    ****  ** ******************************  **********     
**************           ********************* **  ************  **  ** **   *** ******************************** *********     
***********    ******************************* **   ********    **   *  **   *** *****************************       ******     
**********  ********************************** ***  *******     *   **  *    *** *****************************  ***********     
************   ******************************* ***   *****     *   ***      **** ****************************** ***********     
************** ******************************* ****   **          ****    ****** ******************************* **********     
************** ******************************* ****   **          ****    ****** ******************************* **********     
************* ******************************** *****      *      *****    ****** ******************************* **********     
************* *******************************  *****     **     ****** * ******* ******************************* **********     
************* *******************************  *******   **    ********* ******** ******************************* *********     
*********************************************  ********  **    ****************** ******************************* *********     
************ ********************************  ********************************** ******************************* *********     
************ ******************************** *********************************** ******************************  *********     
************ ******************************** **************   ******************  ****************************** *********     
************ ******************************** **************   ******************* *****************************  *********     
************ ******************************** *************    ***** *************  ****************************  *********     
************  ******************************* *************    **** **************  ****************************  *********     
************  ******************************* *************    **** **************  ****************************  *********     
************* ******************************  *************    *** ***************   *************************** **********     
************* ****************************** *************     ** *****************  *************************** **********     
************* *****************************  ************* *   * ******************  **************************  **********     
************* ***************************** ************** *    ******************** **************************  **********     
******************************************* ************* **    ********************  *************************  **********     
************** ****************************************** ***************************  ************************* **********     
************** *************************** ************** ***************************   ************************ **********     
************** ************************** *************** ***************************   ************************ **********     
************** *************************  *************** ***************************   ************************ **********     
************** ************************  ***************** *************************      ********************** **********     
************** ************************  ***************** *************************      ********************** **********     
************** ************************  ***************** ************************ **    ********************** **********     
************** ***********************  *  *   ************ ********************** ***     *********************  *********     
************** **********************   *** **   ********** ****************** ** ****     *********************  *********     
************** *********************    *******   * ********************* *** ** *****      ********************  *********     
************** *********************    ********* ** ******************** *** ** ****       ********************  *********     
************** ********************     *  ********* ******************** ** *****          ********************  *********     
************** ********************           ******* * **************** *  *****   ***     ********************  *********     
**************  *****************     **  **   ****** * ******************  ****   * *       *******************  *********     
**************  *****************    *       *   **** ** **********************  *     **** *******************  **********     
**************  *****************           *     ***************************** *      **** ************ ****** ***********     
**************  *****************           *     ***************************** *      **** ************ ****** ***********     
**************   ****************   *      *       ****** ********************  *   *  **** ************ ***** ************     
**************   ****************   *      *  **** *************************** *       **** ********     ****  ************     
***************   *****  ********  *       * ***** **************************  *     *      ********     ****  ************     
***************    ****   *******  *          **** **************************        *      *******      ***  *************     
***************   *   *    ******  *********  ****  *************************  *********    *****        **   *************     
***************             *****  **********       *************************  ***********  ****         **   *************     
***************       *      ****  ***********      ********************* ***  *********** ****    *    **    *************     
***************  *       *    ***  ************     * ******************* **** *********** ***    ***   *     *************     
***************  *****    *     *  ************     * **** *************  **** **  *****   *     ****     **  *************     
***************  ******   ***       ***********    *** *** *************  ****      ****        ****     ***  *************     
***************  ******   ***       ***********    *** *** *************  ****      ****        ****     ***  *************     
**************   *******   **       *************  **  *** *          *   ***** *** ****       *****    ****   ************     
**************   ********  ***      **    *******  ** * *   ************    *** *** *******   ****** *****      ***********     
**************   **************  **   *** *****    * * *******************   *** * *******   ****** ********    ***********     
*************     ************** ***  *** *****   **  ******          ************ *****    *****************    **********     
************   **  **************  **  *  *      ** ******* *************************      *************          *********     
***********  ***************************   *********************************************   ********************   *********     
********** **************************** *************************************************************************  ********     
*********        ******************************************            *******************************************   ******     
********   *********************************************   ***********   ******************************************   *****     
********  *********************************************  **************** *******************************************  ****     
********  *********************************************  **************** *******************************************  ****     
******** *********************** ********************* ******************   *****************************************  ****     
******  *********************************************  *******************  ******************************************  ***     
*****   *********************** *********************  *******************  ******************************************  ***     
***** ***********************************************  *******************  *******************************************  **     
**** ************************* *********************** *******************  ******************* *******************   *  **     
***  ************************* *********************** ****************** *******************************************     *     
*** *   ********************* ************************  ***************** ********************************************    *     
**    ************************************************* **************** *********************** *********************          
**    *********************** ************************** ************** ***********************************************         
*     *************************************************** ************* **** *******************************************  *     
*     *************************************************** ************* **** *******************************************  *     
*  * **** ** ************************************  ******* *********** ************************** **********************  *     
  ** ***  * *********************************************** ********  **************************************************  *     
 ***      **************************************************    ***  *************************************************    *     
****     ******************** *********************************     ***************************************************         
****     *******************************************************  *****************************************************         
****     *******************************************************   ************* ****   ******** **********************         
****     **** ***************  ************************  *******   **  ********* ****** *******************************  *      
****  ** **** ************************** *****   ***************   *******************    *****************************  **     
****      *** **************** *********  **********************   ******************* *  ***** ***********************  **     
***** **  *****************************    ********************     ***************** ********************************   **     
***** **  *****************************    ********************     ***************** ********************************   **     
***** **  ********************* ******* ** *****************        ***************  *********************************  ***     
********  **** ****************************  **************          ************  ***********  **********************  ***     
********  ***********************************  **********              ********   ****************************** * **  ****     
********  ***************************************   *    ***     ******        *************** *******************     ****     
*********  ** *************************************     ******* *********     ************** ********************     *****     
*********  **  **************************************  ******** **********    *********************************** *   *****     
**********  * * *************************************  ******** **********   ***********************************  *  ******     
***********   *  * *******************   ************ ********* **********   ********************************* * **********     
***********   **  **** *****************  *********** ********* **********   ***********    *****************    **********     
************  ****    *    **************  ********** ******   ***********  ***********   *****************     ***********     
************  ****    *    **************  ********** ******   ***********  ***********   *****************     ***********     
*************  ****    *    *********** **   ******** ******   ***********  *********   *****************      ************     
************** *******  ***    ******      *  ******  ******   ***********  ********      ********       **  **************     
************************  ***           *****  *****  ********* **********  *******  ***            ****** ****************     
**********************************************   ***  ********* **********  ***** *****************************************     
************************************************* *** ********* ********* ***** *******************************************     
**************************************************    ******************* **** ********************************************     
***************************************************   *******************     *********************************************     
***************************************************** ******************    ***********************************************     
*****************************************************  ****************  **************************************************     
****************************************************** ****************  **************************************************     
****************************************************** ****************  **************************************************     
******************************************************  **************  ***************************************************     
*******************************************************   **********  *****************************************************     
********************************************************             ******************************************************     
**********************************************************          *******************************************************     
*/

/* Image data */
unsigned int ImgWidthBytes = 16;
unsigned int ImgWidthPixels = 123;
unsigned int ImgHeightPixels = 120;
unsigned int ImgTotalBytes = 1920;

const char ImgArray[] PROGMEM = {
0xFF,0xFF,0xFF,0xFF,0xFF,0xFF,0xFF,0xFF,0xFF,0xFF,0xFF,0xFF,0xFF,0xFF,0xFF,0xE0,
0xFF,0xFF,0xFF,0xFF,0xFF,0xFF,0xFF,0xFF,0xFF,0xFF,0xFF,0xFF,0xFF,0xFF,0xFF,0xE0,
0xFF,0xFF,0xFF,0xFF,0xFF,0xFF,0xFF,0xFF,0xFF,0xFF,0xFF,0xFF,0xFF,0xFF,0xFF,0xE0,
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0xFF,0xFF,0xFF,0xFF,0xFF,0xFF,0xFF,0xC0,0x0F,0xFF,0xFF,0xFF,0xFF,0xFF,0xFF,0xE0,
};

#include <Adafruit_GFX.h>    // Core graphics library
#include <Adafruit_TFTLCD.h> // Hardware-specific library

#define  BLACK   0x0000
#define WHITE   0xFFFF

Adafruit_TFTLCD tft(A0, A1, A2, A3, A4);

void setup() {
  // put your setup code here, to run once:
  tft.reset();

  Serial.begin(9600);

  uint16_t identifier = tft.readID();
  
  tft.begin(identifier);
  
  tft.fillScreen(WHITE);
  
  draw_Image(ImgArray);

}

void loop() {
  // put your main code here, to run repeatedly:

}

void draw_Image(const char *inImg)
{
  tft.fillRect(0,0,120,120,WHITE);

  int x=0;
  int y=0;

  /* Loop through rows */
  for(int i=0;i<ImgHeightPixels;i++)
  {
    /* loop through bytes of collumn */
    for(int j=0;j<ImgWidthBytes;j++)
    {
      unsigned char pixelData =  pgm_read_byte_near(inImg + i*ImgWidthBytes + j);

      /* each byte represents 8 pixels except maybe the last. */
      for(int k=1;k<=8;k++)
      {
        /* if last byte in row and there are bits in byte not representing pixels (padding) stop parsing collumn when these bits are reached. */
        if(j==ImgWidthBytes-1 && (ImgWidthPixels%8) && (ImgWidthPixels%8)>k)
        {
          break;
        }

        /* read the bit and draw a pixel if its not set*/
        if(!(pixelData&(1<<(8-k))))
        {
          tft.drawPixel(x,y, BLACK);
          Serial.print("*");
        }
        else
        {
          Serial.print(" ");
        }
        x++;
      }      
    }

    Serial.println("");
    x=0;
    y++;
  }
}
